## boards/shields/egret/Kconfig.defconfig
```kconfig
if SHIELD_EGRET_LEFT

config ZMK_KEYBOARD_NAME
    default "Egret"

config ZMK_SPLIT_ROLE_CENTRAL
    default y

endif

if SHIELD_EGRET_LEFT || SHIELD_EGRET_RIGHT

config ZMK_SPLIT
    default y

endif
```

## boards/shields/egret/Kconfig.shield
```kconfig
config SHIELD_EGRET_LEFT
    def_bool $(shields_list_contains,egret_left)

config SHIELD_EGRET_RIGHT
    def_bool $(shields_list_contains,egret_right)
```

## config/west.yml
```yaml
manifest:
  defaults:
    revision: v0.3
  remotes:
    - name: zmkfirmware
      url-base: https://github.com/zmkfirmware
    - name: fishjord
      url-base: https://gitea.chrono.zone/fishjord
  projects:
    - name: zmk
      remote: zmkfirmware
      revision: main
      import: app/west.yml
    - name: zmk-module
      remote: fishjord
      revision: main
  self:
    path: config
```
